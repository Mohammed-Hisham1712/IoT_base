## components/IO_Component/Kconfig
```kconfig
menu "IO component"

config IO_COMPONENT_INCLUDED
    bool "add input output component to the system"
    default y

menu "Input Handler" 
    config ON_OFF_INPUT_HANDLER
    bool "add on off input handler"
    depends on IO_COMPONENT_INCLUDED
    default n

    config PRESSED_INPUT_HANDLER
    bool "add pressed input handler"
    depends on IO_COMPONENT_INCLUDED
    default n

menu "On off input handler" # inside input handler menu
    depends on ON_OFF_INPUT_HANDLER

    
endmenu # end of on off input handler menu
menu "pressed input handler" # inside input handler menu
    depends on PRESSED_INPUT_HANDLER

    config MAX_NUMBER_OF_PRESSED_SWITCHES
    int "maximum number of pressed input"
    range 1 6
    default 3
    help 
        choose the maximum number of pressed input

if MAX_NUMBER_OF_PRESSED_SWITCHES >= 2
    config USE_SWITCH_2_CONFIG
    bool 
    default y
endif
if MAX_NUMBER_OF_PRESSED_SWITCHES >= 3
    config USE_SWITCH_3_CONFIG
    bool
    default y
endif
if MAX_NUMBER_OF_PRESSED_SWITCHES >= 4
    config USE_SWITCH_4_CONFIG
    bool
    default y
endif
if MAX_NUMBER_OF_PRESSED_SWITCHES >= 5
    config USE_SWITCH_5_CONFIG
    bool
    default y
endif
if MAX_NUMBER_OF_PRESSED_SWITCHES >= 6
    config USE_SWITCH_6_CONFIG
    bool
    default y
endif
    
    choice 
        prompt "Select pressed switch 1 pin"
        default NON
    config PRESSED_SWITCH_1_PIN_0
        bool "PIN_0" 
    config PRESSED_SWITCH_1_PIN_1
        bool "PIN_1" 
    config PRESSED_SWITCH_1_PIN_2
        bool "PIN_2" 
    config PRESSED_SWITCH_1_PIN_3
        bool "PIN_3" 
    config PRESSED_SWITCH_1_PIN_4
        bool "PIN_4" 
    config PRESSED_SWITCH_1_PIN_5
        bool "PIN_5" 
    config PRESSED_SWITCH_1_PIN_6
        bool "PIN_6" 
    config PRESSED_SWITCH_1_PIN_7
        bool "PIN_7" 
    config PRESSED_SWITCH_1_PIN_8
        bool "PIN_8" 
    config PRESSED_SWITCH_1_PIN_9
        bool "PIN_9"
    endchoice

    choice 
        depends on USE_SWITCH_2_CONFIG
        prompt "Select pressed switch 2 pin"
        default NON
    config PRESSED_SWITCH_2_PIN_0
    bool "PIN_0" 
    config PRESSED_SWITCH_2_PIN_1
        bool "PIN_1" 
    config PRESSED_SWITCH_2_PIN_2
        bool "PIN_2" 
    config PRESSED_SWITCH_2_PIN_3
        bool "PIN_3" 
    config PRESSED_SWITCH_2_PIN_4
        bool "PIN_4" 
    config PRESSED_SWITCH_2_PIN_5
        bool "PIN_5" 
    config PRESSED_SWITCH_2_PIN_6
        bool "PIN_6" 
    config PRESSED_SWITCH_2_PIN_7
        bool "PIN_7" 
    config PRESSED_SWITCH_2_PIN_8
        bool "PIN_8" 
    config PRESSED_SWITCH_2_PIN_9
        bool "PIN_9" 
    endchoice

    choice 
    depends on USE_SWITCH_3_CONFIG
        prompt "Select pressed switch 3 pin"
        default NON
    config PRESSED_SWITCH_3_PIN_0
    bool "PIN_0" 
    config PRESSED_SWITCH_3_PIN_1
        bool "PIN_1" 
    config PRESSED_SWITCH_3_PIN_2
        bool "PIN_2" 
    config PRESSED_SWITCH_3_PIN_3
        bool "PIN_3" 
    config PRESSED_SWITCH_3_PIN_4
        bool "PIN_4" 
    config PRESSED_SWITCH_3_PIN_5
        bool "PIN_5" 
    config PRESSED_SWITCH_3_PIN_6
        bool "PIN_6" 
    config PRESSED_SWITCH_3_PIN_7
        bool "PIN_7" 
    config PRESSED_SWITCH_3_PIN_8
        bool "PIN_8" 
    config PRESSED_SWITCH_3_PIN_9
        bool "PIN_9" 
    endchoice
    choice 
    depends on USE_SWITCH_4_CONFIG
        prompt "Select pressed switch 4 pin"
        default NON
    config PRESSED_SWITCH_4_PIN_0
    bool "PIN_0" 
    config PRESSED_SWITCH_4_PIN_1
        bool "PIN_1" 
    config PRESSED_SWITCH_4_PIN_2
        bool "PIN_2" 
    config PRESSED_SWITCH_4_PIN_3
        bool "PIN_3" 
    config PRESSED_SWITCH_4_PIN_4
        bool "PIN_4" 
    config PRESSED_SWITCH_4_PIN_5
        bool "PIN_5" 
    config PRESSED_SWITCH_4_PIN_6
        bool "PIN_6" 
    config PRESSED_SWITCH_4_PIN_7
        bool "PIN_7" 
    config PRESSED_SWITCH_4_PIN_8
        bool "PIN_8" 
    config PRESSED_SWITCH_4_PIN_9
        bool "PIN_9"
    endchoice
    choice 
    depends on USE_SWITCH_5_CONFIG
        prompt "Select pressed switch 5 pin"
        default NON
        config PIN_0
    config PRESSED_SWITCH_5_PIN_0
        bool "PIN_0" 
    config PRESSED_SWITCH_5_PIN_1
        bool "PIN_1" 
    config PRESSED_SWITCH_5_PIN_2
        bool "PIN_2" 
    config PRESSED_SWITCH_5_PIN_3
        bool "PIN_3" 
    config PRESSED_SWITCH_5_PIN_4
        bool "PIN_4" 
    config PRESSED_SWITCH_5_PIN_5
        bool "PIN_5" 
    config PRESSED_SWITCH_5_PIN_6
        bool "PIN_6" 
    config PRESSED_SWITCH_5_PIN_7
        bool "PIN_7" 
    config PRESSED_SWITCH_5_PIN_8
        bool "PIN_8" 
    config PRESSED_SWITCH_5_PIN_9
        bool "PIN_9" 
    endchoice
    choice 
    depends on USE_SWITCH_6_CONFIG
        prompt "Select pressed switch 6 pin"
        default NON
    config PRESSED_SWITCH_6_PIN_0
    bool "PIN_0" 
    config PRESSED_SWITCH_6_PIN_1
        bool "PIN_1" 
    config PRESSED_SWITCH_6_PIN_2
        bool "PIN_2" 
    config PRESSED_SWITCH_6_PIN_3
        bool "PIN_3" 
    config PRESSED_SWITCH_6_PIN_4
        bool "PIN_4" 
    config PRESSED_SWITCH_6_PIN_5
        bool "PIN_5" 
    config PRESSED_SWITCH_6_PIN_6
        bool "PIN_6" 
    config PRESSED_SWITCH_6_PIN_7
        bool "PIN_7" 
    config PRESSED_SWITCH_6_PIN_8
        bool "PIN_8" 
    config PRESSED_SWITCH_6_PIN_9
        bool "PIN_9" 
    endchoice

endmenu # end of pressed input handler menue
choice
    prompt "Select number of pressed inputs"


endchoice #end of num of switch chice


endmenu # end of INPUT HANDLER menu

menu "Output Handler"

endmenu # end of OUTPUT HANDLER menu

menu "IO processor"

endmenu # end of IO processor menu

endmenu # end of IO component menu
```

## components/appl_config/Kconfig.projbuild
```kconfig
menu "Application config"

config APPLICATION_START_MARK
	bool
	default y

choice MCU_TARGET
	prompt "Select target MCU"
	default TARGET_ESP8266
	help
		Select MCU target to build for
		- ESP8266
		- ESP32
		- STM32
	config TARGET_ESP8266
		bool "ESP8266"
	
	config TARGET_ESP32
		bool "ESP32"
	
	config TARGET_STM32
		bool "STM32"

endchoice

menu "IO_component"
	source "$COMPONENTS_PATH_ENV/IO_Component/IO_Kconfig"
endmenu

menu "System Param"
	source "$COMPONENTS_PATH_ENV/system_param_component/system_param_comp_Kconfig"
endmenu

menu "WIFI component"
	source "$COMPONENTS_PATH_ENV/WIFI_Component/WIFI_Kconfig"
endmenu


config APPLICATION_END_MARK
	bool
	default y

endmenu
```
